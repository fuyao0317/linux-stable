// SPDX-License-Identifier: (GPL-2.0+ OR MIT)

/dts-v1/;

#include "sun8i-t113-llz.dtsi"

/ {
	model = "LLZ T113 V1 (SD Card)";
	compatible = "widora,mangopi-mq-r-t113", "allwinner,sun8i-t113s";

	chosen {
		bootargs = "root=/dev/mmcblk0p2 rootwait rw";
	};
};
